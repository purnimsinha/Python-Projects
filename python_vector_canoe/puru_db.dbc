VERSION ""

NS_ :

BS_:

BU_: swt_right swt_left

BO_ 1 swt_right_on: 1 swt_right
 SG_ sgn_right : 0|8@1- (1,0) [-128|127] "" Vector__XXX

BO_ 0 swt_left_on: 1 swt_left
 SG_ sgn_left : 0|8@1- (1,0) [-128|127] "" Vector__XXX
